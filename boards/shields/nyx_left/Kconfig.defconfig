## boards/shields/nyx_left/Kconfig.defconfig
```kconfig
if SHIELD_NYX_LEFT
# Name that shows over USB/BLE (≤15 chars)
config ZMK_KEYBOARD_NAME
    default "Nyx L"
endif
```

## boards/shields/nyx_right/Kconfig.defconfig
```kconfig
if SHIELD_NYX_RIGHT
# USB/BLE advertising name (≤15 chars)
config ZMK_KEYBOARD_NAME
    default "Nyx R"
endif
```

## boards/shields/nyx_right/Kconfig.shield
```kconfig
# nyx_left shield marker
config SHIELD_NYX_LEFT
    def_bool $(shields_list_contains,nyx_left)
```

## config/boards/shields/nyx/Kconfig.defconfig
```kconfig
# Nyx Split Keyboard Configuration Defaults
# This file defines configuration settings applied when shields are active

# Configuration for left half (central)
if SHIELD_NYX_LEFT

config ZMK_KEYBOARD_NAME
    default "Nyx"

config ZMK_SPLIT_ROLE_CENTRAL
    default y

endif

# Configuration for right half (peripheral)
if SHIELD_NYX_RIGHT

config ZMK_KEYBOARD_NAME
    default "Nyx"

endif

# Configuration for both halves
if SHIELD_NYX_LEFT || SHIELD_NYX_RIGHT

config ZMK_SPLIT
    default y

endif
```

## config/boards/shields/nyx/Kconfig.shield
```kconfig
# Nyx Split Keyboard Shield Configuration
# This file defines shield detection flags only

config SHIELD_NYX_LEFT
    def_bool $(shields_list_contains,nyx_left)

config SHIELD_NYX_RIGHT
    def_bool $(shields_list_contains,nyx_right)
```
