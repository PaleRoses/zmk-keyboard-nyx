
/*
 * Nyx Split Keyboard - Left Half Overlay
 * Role: Central (receives key data from peripheral)
 * Matrix: Columns 0‑5 (of 0‑11 total)
 */

#include "nyx.dtsi"

/* Column pins (P0.08, P0.17, P0.20, P0.22, P0.24, P1.00) */
&kscan0 {
    col-gpios = <&gpio0  8 (GPIO_ACTIVE_HIGH | GPIO_PULL_DOWN)>,
                <&gpio0 17 (GPIO_ACTIVE_HIGH | GPIO_PULL_DOWN)>,
                <&gpio0 20 (GPIO_ACTIVE_HIGH | GPIO_PULL_DOWN)>,
                <&gpio0 22 (GPIO_ACTIVE_HIGH | GPIO_PULL_DOWN)>,
                <&gpio0 24 (GPIO_ACTIVE_HIGH | GPIO_PULL_DOWN)>,
                <&gpio1  0 (GPIO_ACTIVE_HIGH | GPIO_PULL_DOWN)>;
};
