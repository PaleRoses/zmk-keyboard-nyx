/*
 * Nyx Split Keyboard - Right Half Overlay
 * Role: Peripheral (sends key data to central)
 * Matrix: Columns 6‑11 (of 0‑11 total)
 */

#include "nyx.dtsi"

/* Column pins (P0.08, P0.17, P0.20, P0.22, P0.24, P1.00) */
&kscan0 {
    col-gpios = <&gpio0  8 (GPIO_ACTIVE_HIGH | GPIO_PULL_DOWN)>,
                <&gpio0 17 (GPIO_ACTIVE_HIGH | GPIO_PULL_DOWN)>,
                <&gpio0 20 (GPIO_ACTIVE_HIGH | GPIO_PULL_DOWN)>,
                <&gpio0 22 (GPIO_ACTIVE_HIGH | GPIO_PULL_DOWN)>,
                <&gpio0 24 (GPIO_ACTIVE_HIGH | GPIO_PULL_DOWN)>,
                <&gpio1  0 (GPIO_ACTIVE_HIGH | GPIO_PULL_DOWN)>;
    
    /* Offset columns by 6 to map to columns 6-11 in the matrix */
    col-offset = <6>;
};